## scripts/lib/wic/canned-wks/trustmeimage.wks
```
# short-description: Create SD card image with a boot partition
# long-description: Creates a partitioned SD card image. Boot files
# are located in the first vfat partition.

part /boot --source trustmeboot --ondisk sdb --label boot --active --align 4 --size 16
part /modules --source trustmemodules --ondisk sdc --fstype=ext4 --label modules --align 4
part /data --source trustmedata --ondisk sdd --fstype=ext4 --label data --align 4

bootloader  --ptable gpt"
```
